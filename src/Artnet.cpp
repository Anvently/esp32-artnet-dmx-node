#include "Artnet.hpp"

#if DMX_OUTPUT_NBR == 1

//Set the active universe for each DMX output. Artnet packet intended to one of the universe
//configured in universeMap will be forwarded to the correct output
uint16_t	Artnet::universeMap[DMX_OUTPUT_NBR] = {DMX_OUTPUT1_DFT_UNIVERSE};

#elif DMX_OUTPUT_NBR == 2

//Set the active universe for each DMX output. Artnet packet intended to one of the universe
//configured in universeMap will be forwarded to the correct output
uint16_t	Artnet::universeMap[DMX_OUTPUT_NBR] = {DMX_OUTPUT1_DFT_UNIVERSE, DMX_OUTPUT2_DFT_UNIVERSE};

#endif
static const char*	TAG = "Artnet";
/*

+----------------+--------------------------------------+--------------------------------------+-------------------------+--------------------------+--+--+--+--+--+
| offset (bytes) | 0                                    | 1                                    | 2                       | 3                        |  |  |  |  |  |
+----------------+--------------------------------------+--------------------------------------+-------------------------+--------------------------+--+--+--+--+--+
| 0              | 'A'                                  | 'r'                                  | 't'                     | '-'                      |  |  |  |  |  |
| 4              | 'N'                                  | 'e'                                  | 't'                     | 0                        |  |  |  |  |  |
| 8              |                     Opcode ArtDMX (0x5000) little endian                    | Protocol Version Hi (0) | Protocol Version Lo (14) |  |  |  |  |  |
| 12             | Sequence                             | Physical                             | Universe little endian                             |  |  |  |  |  |
| 16             | Length Hi                            | Length Lo (2 to 512, even)           | Data                    | Data                     |  |  |  |  |  |
| 20             |                                      |                                      |                         |                          |  |  |  |  |  |
| Data ...       |                                      |                                      |                         |                          |  |  |  |  |  |
|                |                                      |                                      |                         |                          |  |  |  |  |  |
|                |                                      |                                      |                         |                          |  |  |  |  |  |
+----------------+--------------------------------------+--------------------------------------+-------------------------+--------------------------+--+--+--+--+--+

For 16 bits value, high bits is sent first

Byte 0-7 => "Artnet"
8-9      => Opcode => 0x5000 for Dmx512 data
10-11    => Protocol version => current version is 14
12       => sequence => order of dmx packet, can be left to 0x00
13       => The physical input port from which DMX512 data was input. This field is used by the receiving device to discriminate between
			packets with identical Port-Address that have been generated by different input ports and so need to be merged.
			Can be left to 0x00
14 - 15  => Universe to which the frame is intended 
16 - 17  => Length of DMX frame, must be a multiple of 2
18 - ... => Dmx data

*/
int i = 0x5000;
char c = '\x50';
uint8_t	Artnet::artnetToDmx(const char* buffer, uint16_t size)
{
	if (size < 19 || strncmp(buffer, "Art-Net\0\x50\x00", 10)) // If packet is not a ArtDMX packet
		return (ARTNET_ERROR_INVALID_PACKET);
	//Ignore protocol version/sequence/physical
	uint16_t	universe = ((uint16_t)buffer[14] << 8) | buffer[15];
	uint16_t	length = ((uint16_t)buffer[16] << 8) | buffer[17];
	if (length == 0)
		length = size - 18;
	if (length > 512 || (length + 18) != size)
		return (ARTNET_ERROR_INVALID_PACKET);
	for (uint8_t i = 0; i < DMX_OUTPUT_NBR; i++)
	{
		if (universe == Artnet::universeMap[i])
		{
			ESP_LOGD(TAG, "Packet of %hu channels intended to output %hhu", length, i);
			Dmx::universes[i].setBuffer((uint8_t*)buffer + 18, length);
		}
	}
	return (0);
}


